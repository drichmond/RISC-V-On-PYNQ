/*----------------------------------------------------------------------*/
/* Sections                                                             */
/*----------------------------------------------------------------------*/

MEMORY {
	mem : ORIGIN = 0x00000000, LENGTH = 0x00010000
}

SECTIONS {
	.memory : {
		. = 0x000000;
		_init*(.text);
		trap_vector*(.text);
		*(.text);
		*(*);
		. = ALIGN(8);
		end = .;
	} > mem
}
